## components/reset_button/Kconfig.projbuild
```kconfig
menu "Reset Button"

    config RESET_BUTTON_ENABLED
        bool "Enable factory-reset button"
        default y if ESP32_S3_XIAO_AUDIO_HAT_BOARD
        default n
        help
            Hold the configured GPIO button to clear persisted Wi-Fi/HaLow
            credentials and reboot.

    config RESET_BUTTON_GPIO
        int "Reset button GPIO number"
        depends on RESET_BUTTON_ENABLED
        default 11 if ESP32_S3_XIAO_AUDIO_HAT_BOARD
        default -1
        help
            GPIO that the factory-reset button is wired to.

    config RESET_BUTTON_ACTIVE_LOW
        bool "Button is active low (pull-up to VCC, press shorts to GND)"
        depends on RESET_BUTTON_ENABLED
        default y

    config RESET_BUTTON_HOLD_MS
        int "Long-press hold duration (ms)"
        depends on RESET_BUTTON_ENABLED
        default 5000
        help
            How long the button must be held before credentials are erased.

endmenu
```

## components/status_led/Kconfig.projbuild
```kconfig
menu "Status LED"

	config STATUS_LED_ENABLED
		bool "Enable WS2812B status LED"
		default y if ESP32_S3_XIAO_AUDIO_HAT_BOARD
		default n
		help
			Enable a WS2812B addressable LED for status indication.

	config STATUS_LED_GPIO
		int "Status LED GPIO number"
		depends on STATUS_LED_ENABLED
		default 10 if ESP32_S3_XIAO_AUDIO_HAT_BOARD
		default -1
		help
			GPIO pin connected to the WS2812B data line.

endmenu
```

## sdkconfig.defaults.seeed_halow_xiao_FGH100M_H
```kconfig
# Seeed Studio XIAO HaLow Transceiver (MorseMicro MM6108)
# 8 MB flash — partitions.csv (2x3M OTA + data) needs >4 MB.
# CONFIG_ESPTOOLPY_FLASHSIZE_4MB is not set
CONFIG_ESPTOOLPY_FLASHSIZE_8MB=y
CONFIG_ESPTOOLPY_FLASHSIZE="8MB"

CONFIG_SNAPCLIENT_USE_HALOW=y
CONFIG_HALOW_COUNTRY_CODE="AU"
CONFIG_MMHAL_CHIP_TYPE_MM6108=y
# CONFIG_MMHAL_CHIP_TYPE_MM8108 is not set
CONFIG_MM_FW_FILE="mm6108.mbin"
CONFIG_MM_BCF_FILE="bcf_fgh100mhaamd.mbin"

# GPIO pinout on XIAO ESP32-S3
CONFIG_MM_RESET_N=1
CONFIG_MM_WAKE=2
CONFIG_MM_BUSY=5
CONFIG_MM_SPI_SCK=7
CONFIG_MM_SPI_MOSI=9
CONFIG_MM_SPI_MISO=8
CONFIG_MM_SPI_CS=4
CONFIG_MM_SPI_IRQ=3

# Disable PM/tickless idle
# CONFIG_PM_ENABLE is not set
# CONFIG_FREERTOS_USE_TICKLESS_IDLE is not set

# Move Wi-Fi/LWIP buffers to PSRAM
CONFIG_SPIRAM_TRY_ALLOCATE_WIFI_LWIP=y

CONFIG_ENABLE_HALOW_PROVISIONING=y
CONFIG_HALOW_PROV_POP="longwave"
```

## sdkconfig.defaults.xaio-audio-hat
```kconfig
CONFIG_ESP32_S3_XIAO_AUDIO_HAT_BOARD=y
CONFIG_USE_DSP_PROCESSOR=y
CONFIG_SNAPCLIENT_USE_SOFT_VOL=y
```
